## config/west.yml
```yaml
manifest:
  remotes:
    - name: ergohaven
      url-base: https://github.com/ergohaven
    - name: urob
      url-base: https://github.com/urob
    - name: eintim
      url-base: https://github.com/eintim
  projects:
    - name: ergohaven-zmk
      remote: ergohaven
      revision: main
      import: config/west.yml
    - name: zmk-tri-state
      remote: urob
      revision: main
    - name: zmk-behavior-battery-typer
      remote: eintim
      revision: main
  self:
    path: config
```
